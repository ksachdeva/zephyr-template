## west.yml
```yaml
manifest:
  self:    
    path: .    

  remotes:
    - name: zephyrproject-rtos
      url-base: https://github.com/zephyrproject-rtos

  projects:
    - name: zephyr
      remote: zephyrproject-rtos
      revision: v4.3.0
      import: 
        path-prefix: deps
```
